/*
 * Copyright (c) 2020 The ZMK Contributors
 *
 * SPDX-License-Identifier: MIT
 */

#include <behaviors.dtsi>
#include <dt-bindings/zmk/keys.h>
#include <dt-bindings/zmk/bt.h>
#include <dt-bindings/zmk/rgb.h>
#include <dt-bindings/zmk/ext_power.h>

#define BASE 0
#define LOWER 1
#define RAISE 2
#define ADJUST 3

&kscan0 {
	row-gpios
	  = <&gpio0 17 (GPIO_ACTIVE_HIGH | GPIO_PULL_DOWN)>
	  , <&gpio0 20 (GPIO_ACTIVE_HIGH | GPIO_PULL_DOWN)>
	  , <&gpio0 22 (GPIO_ACTIVE_HIGH | GPIO_PULL_DOWN)>
	  , <&gpio0 24 (GPIO_ACTIVE_HIGH | GPIO_PULL_DOWN)>
	  , <&gpio1 0 (GPIO_ACTIVE_HIGH | GPIO_PULL_DOWN)>
	  ;
	 col-gpios
	  = <&gpio1 11 GPIO_ACTIVE_HIGH >
	  , <&gpio1 13 GPIO_ACTIVE_HIGH >
	  , <&gpio1 15 GPIO_ACTIVE_HIGH >
	  , <&gpio0 2  GPIO_ACTIVE_HIGH >
	  , <&gpio0 11 GPIO_ACTIVE_HIGH >
	  , <&gpio1 4  GPIO_ACTIVE_HIGH >
	  ;
};
